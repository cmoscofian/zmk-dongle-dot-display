## boards/shields/dot_display/Kconfig.defconfig
```kconfig
# Copyright (c) 2024 The ZMK Contributors
# SPDX-License-Identifier: MIT

if SHIELD_DOT_DISPLAY

choice ZMK_DISPLAY_STATUS_SCREEN
	default ZMK_DISPLAY_STATUS_SCREEN_CUSTOM
endchoice

config ZMK_DISPLAY_STATUS_SCREEN_CUSTOM
	select LV_USE_LABEL
	select LV_FONT_MONTSERRAT_28
	select ZMK_WPM

choice ZMK_DISPLAY_WORK_QUEUE
	default ZMK_DISPLAY_WORK_QUEUE_DEDICATED
endchoice

config LV_Z_MEM_POOL_SIZE
	default 16384

config LV_Z_VDB_SIZE
	default 100

config LV_DPI_DEF
	default 148

config LV_Z_BITS_PER_PIXEL
	default 1

choice LV_COLOR_DEPTH
	default LV_COLOR_DEPTH_1
endchoice

endif
```

## boards/shields/dot_display/Kconfig.shield
```kconfig
# Copyright (c) 2026 The ZMK Contributors
# SPDX-License-Identifier: MIT

config SHIELD_DOT_DISPLAY
	def_bool $(shields_list_contains,dot_display)
```

## config/west.yml
```yaml
manifest:
    remotes:
        - name: zmkfirmware
          url-base: https://github.com/zmkfirmware
    projects:
        - name: zmk
          remote: zmkfirmware
          revision: main
          import: app/west.yml
    self:
        path: config

# vim: ft=yaml et sw=4 sts=4 ts=4
```
